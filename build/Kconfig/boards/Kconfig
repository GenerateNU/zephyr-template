## build/Kconfig/boards/Kconfig
```kconfig
# Load Zephyr board Kconfig descriptions.
osource "/Users/jacksweeney/zephyrproject/zephyr/boards/qemu/x86/Kconfig"
```

## build/Kconfig/boards/Kconfig.defconfig
```kconfig
# Load Zephyr board defconfig descriptions.
osource "/Users/jacksweeney/zephyrproject/zephyr/boards/qemu/x86/Kconfig.defconfig"
```
